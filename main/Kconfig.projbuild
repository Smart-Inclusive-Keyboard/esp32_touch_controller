## main/Kconfig.projbuild
```kconfig
menu "Touch Controller"

# ----------------------------------------------------------------------
# Hardware board selection.
# Each entry "select"s the internal capability flags used by main.c.
# To add a new board: add a config entry here, add a matching
# #ifdef CONFIG_TC_BOARD_<NAME> block in main/main.c with the correct
# pin definitions.
# ----------------------------------------------------------------------

choice TC_BOARD
    prompt "Hardware board"
    default TC_BOARD_WAVESHARE_C6_TOUCH_LCD_147
    help
        Selects the hardware board the firmware is built for.
        The board choice determines all pin assignments and any
        board-specific initialisation parameters.

config TC_BOARD_WAVESHARE_C6_TOUCH_LCD_147
    bool "Waveshare ESP32-C6-Touch-LCD-1.47"
    depends on IDF_TARGET_ESP32C6
    help
        Waveshare ESP32-C6-Touch-LCD-1.47 development board.
        1.47 inch 172x320 portrait IPS LCD with JD9853 SPI
        controller and AXS5106L capacitive touch (I2C).

        LCD SPI (SPI2): SCLK=GPIO1, MOSI=GPIO2, MISO=GPIO3,
                        CS=GPIO14, DC=GPIO15, RST=GPIO22, BL=GPIO23.
        Touch I2C (I2C0): SDA=GPIO18, SCL=GPIO19, INT=GPIO21, RST=GPIO20.
        UART gamepad TX: GPIO9 (CONFIG_TC_UART_TX_GPIO default).

endchoice

# ----------------------------------------------------------------------
# Display appearance
# ----------------------------------------------------------------------

menu "Display"

config TC_SCREEN_BRIGHTNESS
    int "Screen brightness (percent)"
    range 0 100
    default 50
    help
        Backlight brightness as a percentage of full scale, applied to
        the LCD backlight PWM at start-up.  0 turns the backlight off,
        100 drives it at full brightness.

config TC_COLOR_BACKGROUND
    hex "Background colour (0xRRGGBB)"
    default 0x000000
    help
        Screen background colour as a 24-bit 0xRRGGBB value.
        The default is black (0x000000).

config TC_COLOR_FOREGROUND
    hex "Foreground colour (0xRRGGBB)"
    default 0x3333cc
    help
        Foreground colour used for the navigation guide lines, arrows
        and button labels, as a 24-bit 0xRRGGBB value.
        The default is #3333cc (blue).

config TC_COLOR_HIGHLIGHT
    hex "Highlight colour (0xRRGGBB)"
    default 0x33ccff
    help
        Highlight colour briefly applied to the active edge line while
        sliding in impulse mode, as a 24-bit 0xRRGGBB value.
        The default is 0x33ccff (light blue).

config TC_COLOR_CONTINUOUS_IDLE
    hex "Continuous-mode idle colour (0xRRGGBB)"
    default 0xffff00
    help
        Colour of the direction indicator (active edge line) while in
        continuous mode and no sliding gesture is in progress, as a
        24-bit 0xRRGGBB value.  The default is 0xffff00 (yellow).

config TC_COLOR_CONTINUOUS_ACTIVE
    hex "Continuous-mode active colour (0xRRGGBB)"
    default 0xff8000
    help
        Colour of the direction indicator (active edge line) while a
        sliding gesture is detected in continuous mode, as a 24-bit
        0xRRGGBB value.  The default is 0xff8000 (orange).

endmenu  # Display

# ----------------------------------------------------------------------
# UART gamepad output
# ----------------------------------------------------------------------

menu "UART Gamepad Output"

config TC_UART_TX_GPIO
    int "UART TX GPIO number"
    default 9
    range 0 30
    help
        GPIO pin driven as the transmit-only UART output that streams
        6-byte HID gamepad reports to the esp32s3_smart_keyboard.
        GPIO 9 is the default for the Waveshare C6 Touch LCD 1.47.
        Note: on ESP32-C6, GPIOs 12-17 are used by the embedded
        flash/PSRAM and should not be used for other functions.
        GPIOs 26-27 are reserved for USB D+/D-.

config TC_UART_BAUD
    int "Baud rate"
    default 115200
    help
        Baud rate of the 8-N-1 UART link.  Must match the baud rate
        configured in the receiving esp32s3_smart_keyboard firmware
        (SK_GAMEPAD_UART_BAUD, default 115200).

endmenu  # UART Gamepad Output

# ----------------------------------------------------------------------
# Button and mode GPIO inputs
# ----------------------------------------------------------------------

menu "Button inputs"

config TC_BTN0_GPIO
    int "Button 0 GPIO number"
    default 4
    range -1 30
    help
        Pull-up input GPIO that generates game controller button 0
        when pulled low (pressed).  Set to -1 to leave the button
        unassigned (no GPIO is configured for it).

config TC_BTN1_GPIO
    int "Button 1 GPIO number"
    default 5
    range -1 30
    help
        Pull-up input GPIO that generates game controller button 1
        when pulled low (pressed).  Set to -1 to leave the button
        unassigned (no GPIO is configured for it).

config TC_BTN2_GPIO
    int "Button 2 GPIO number"
    default 6
    range -1 30
    help
        Pull-up input GPIO that generates game controller button 2
        when pulled low (pressed).  Set to -1 to leave the button
        unassigned (no GPIO is configured for it).

config TC_BTN3_GPIO
    int "Button 3 GPIO number"
    default 7
    range -1 30
    help
        Pull-up input GPIO that generates game controller button 3
        when pulled low (pressed).  Set to -1 to leave the button
        unassigned (no GPIO is configured for it).

config TC_BTN4_GPIO
    int "Button 4 GPIO number"
    default -1
    range -1 30
    help
        Pull-up input GPIO that generates game controller button 4
        when pulled low (pressed).  Set to -1 to leave the button
        unassigned (no GPIO is configured for it).

config TC_BTN5_GPIO
    int "Button 5 GPIO number"
    default -1
    range -1 30
    help
        Pull-up input GPIO that generates game controller button 5
        when pulled low (pressed).  Set to -1 to leave the button
        unassigned (no GPIO is configured for it).

config TC_BTN6_GPIO
    int "Button 6 GPIO number"
    default -1
    range -1 30
    help
        Pull-up input GPIO that generates game controller button 6
        when pulled low (pressed).  Set to -1 to leave the button
        unassigned (no GPIO is configured for it).

config TC_MODE_GPIO
    int "Impulse/continuous mode GPIO number"
    default 8
    range 0 30
    help
        Pull-up input GPIO that selects the axis output mode.  When left
        open (high) the controller runs in impulse mode; when pulled low
        it switches to continuous mode.  In continuous mode button 9 is
        held on and the active axis is proportional to the sliding
        finger distance from the middle of the touch screen.

        Note: the button GPIOs default to GPIO4-GPIO7 (buttons 0-3),
        with buttons 4-6 left unassigned (-1), and the mode GPIO to
        GPIO8; remap them here to free pins as required.

endmenu  # Button inputs

# ----------------------------------------------------------------------
# Gesture detection thresholds
# ----------------------------------------------------------------------

menu "Gesture thresholds"

config TC_SLIDE_MIN_PX
    int "Minimum slide distance (pixels)"
    range 5 150
    default 25
    help
        Minimum touch travel in pixels (in the primary direction)
        needed to classify a gesture as a slide rather than a tap.
        Reducing this value makes slides easier to trigger but more
        prone to false positives on taps.

config TC_TAP_MAX_MOVE_PX
    int "Maximum tap movement (pixels)"
    range 2 50
    default 15
    help
        Maximum total touch displacement in pixels while the finger
        is down for the gesture to still be classified as a tap.
        Must be smaller than TC_SLIDE_MIN_PX for unambiguous
        gesture separation.

config TC_LONG_TAP_MS
    int "Long-tap threshold (milliseconds)"
    range 200 3000
    default 500
    help
        Minimum contact duration in milliseconds for a stationary
        touch (displacement < TC_TAP_MAX_MOVE_PX) to be classified
        as a long tap, which switches between horizontal and
        vertical operating modes.

config TC_SLIDE_FULL_EVENTS
    int "Axis events per full-length slide"
    range 1 20
    default 3
    help
        Number of axis impulse events generated by a slide that spans
        the full length of the screen.  Shorter slides emit
        proportionally fewer events (always at least one).  Increasing
        this value makes a single long slide advance the navigation
        target by several steps.

endmenu  # Gesture thresholds

endmenu  # Touch Controller
```
